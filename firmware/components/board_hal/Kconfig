## firmware/components/board_hal/Kconfig
```kconfig
menu "Board Configuration"

    config BOARD_CAP_WINDPEEK
        bool
        select UART_ISR_IN_IRAM

    choice BOARD_TYPE
        prompt "Board Driver"
        default BOARD_DRIVER_SEEEDSTUDIO_RETERMINAL_E100X
        help
            Select the power management driver to use.

        config BOARD_DRIVER_SEEEDSTUDIO_RETERMINAL_E1002
            bool "Seeed reTerminal E1002 (Spectra E6)"
            select BOARD_CAP_WINDPEEK
            select SDCARD_DRIVER_SPI
            select SENSOR_DRIVER_SHT40
            select RTC_DRIVER_PCF8563
            select EP_DRIVER_ED2208_GCA
            help
                Driver for Seeed reTerminal E1002 with 7.3" Spectra E6 display.
                Includes battery monitoring and deep sleep support.
                SD card: SPI interface.

        config BOARD_DRIVER_SEEEDSTUDIO_RETERMINAL_E100X
            bool "Seeed reTerminal E1001/E1002 universal carrier"
            select BOARD_CAP_WINDPEEK
            select SDCARD_DRIVER_SPI
            select SENSOR_DRIVER_SHT40
            select RTC_DRIVER_PCF8563
            select EP_DRIVER_ED2208_GCA
            select EP_DRIVER_UC8179_GRAY4_EXPERIMENTAL
            help
                Shared reTerminal E1001/E1002 carrier. The persisted hardware
                profile selects exactly one panel driver at runtime.

        config BOARD_DRIVER_SEEEDSTUDIO_RETERMINAL_E1003
            bool "Seeed reTerminal E1003 (10.3\" Grayscale GC16)"
            select BOARD_CAP_WINDPEEK
            select SDCARD_DRIVER_SPI
            select SENSOR_DRIVER_SHT40
            select RTC_DRIVER_PCF8563
            select EP_DRIVER_IT8951
            help
                Driver for Seeed reTerminal E1003 with 10.3" grayscale display
                (1872x1404, 16-level / GC16) driven by an IT8951 T-CON over SPI.
                Includes SY6974B charger, battery monitoring, and deep sleep.
                SD card: SPI interface (shared bus with the IT8951).

    endchoice

    config USE_INTERNAL_FLASH_STORAGE
        bool "Use internal flash as storage (LittleFS)"
        default y
        help
            Mounts a LittleFS partition from internal flash to use as storage.
            Disable this if your board has limited flash space (e.g. 4MB)
            and you don't have enough space for a storage partition.
            If disabled, the system will use a small RAM-based filesystem (MemFS)
            for temporary runtime files instead.

endmenu
```
